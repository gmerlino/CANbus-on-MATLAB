VERSION ""

NS_ :

BS_:

BU_:

BO_ 800 SunroofControlMsg: 2 Vector__XXX
 SG_ OpenState : 0|4@1+ (1,0) [0|15] "" Vector__XXX

BO_ 600 WindowControlMsg: 4 Vector__XXX
 SG_ DriverDoorWindow : 8|8@1+ (1,0) [0|255] "% open" Vector__XXX
 SG_ PassengerDoorWindow : 0|8@1+ (1,0) [0|255] "% open" Vector__XXX

BO_ 400 DoorControlMsg: 8 Vector__XXX
 SG_ DriverDoorLock : 1|1@1+ (1,0) [0|1] "" Vector__XXX
 SG_ PassengerDoorLock : 0|1@1+ (1,0) [0|1] "" Vector__XXX

BO_ 200 TransmissionMsg: 8 Vector__XXX
 SG_ Gear : 0|4@1+ (1,1) [1|16] "" Vector__XXX

BO_ 100 EngineMsg: 8 Vector__XXX
 SG_ VehicleSpeed : 32|32@1+ (1,0) [0|4294967295] "mph" Vector__XXX
 SG_ EngineRPM : 0|32@1+ (0.1,250) [250|9500] "rpm" Vector__XXX
