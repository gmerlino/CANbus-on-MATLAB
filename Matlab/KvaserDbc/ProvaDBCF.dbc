VERSION ""

NS_ :

BS_:

BU_:

BO_ 100 EngineMsg: 8 Vector__XXX
 SG_ EngineRPM : 0|32@1- (0.1,200) [250|9000] "RPM" Vector__XXX
 SG_ VehicleSpeed : 32|32@1- (1,0) [0|150] "Km/H" Vector__XXX

BO_ 200 DewPointMsg: 8 Vector__XXX
 SG_ Temperature : 0|32@1- (0.1,26) [0|100] "°C" Vector__XXX
 SG_ DewPoint : 32|32@1- (1,0) [0|200] "°C Td" Vector__XXX

CM_ BO_ 100 "This is the EngineMsg that contains EngineRPM and VehicleSpeed";
CM_ BO_ 200 "This is the DewPointMsg that contains Temperature and DewPointMeasure";
